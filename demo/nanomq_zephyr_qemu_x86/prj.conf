## CMakeLists.txt
```
# NanoMQ → Zephyr broker demo.
#
# Cross-compiles the NanoNNG submodule (nng/) with ExternalProject exactly
# like the NanoNNG zephyr_mqtt demo does, then compiles the NanoMQ broker
# core sources (nanomq/nanomq/) against it.
#
# Build:  west build -b qemu_x86 demo/nanomq_zephyr_qemu_x86
# Run:    west build -t run  (SLIRP hostfwd: host tcp:1883 -> guest)

cmake_minimum_required(VERSION 3.20.0)
if(NOT DEFINED ZEPHYR_BASE)
  set(ZEPHYR_BASE $ENV{ZEPHYR_BASE})
endif()
find_package(Zephyr REQUIRED HINTS ${ZEPHYR_BASE})
project(nanomq_zephyr_qemu_x86)

# Repo layout: this demo is <repo>/demo/nanomq_zephyr_qemu_x86; the NanoNNG
# submodule (nng fork incl. nanolib) lives at <repo>/nng.
set(NANOMQ_ROOT ${CMAKE_CURRENT_SOURCE_DIR}/../..)
set(NNG_ROOT ${NANOMQ_ROOT}/nng)

# ── NanoMQ broker core ──────────────────────────────────────────
# Mirror of the SOURCES list in nanomq/nanomq/CMakeLists.txt with three
# deviations:
#   * process.c excluded — pure POSIX (fork/kill/<paths.h>); its symbols
#     (process.h) are provided by src/process_stub.c instead.
#   * plugin/plugin.c excluded — NNG_ENABLE_PLUGIN off.
#   * tests/ excluded — NANOMQ_TESTS off.
target_sources(app PRIVATE
  src/main.c
  src/process_stub.c
  ${NANOMQ_ROOT}/nanomq/bridge.c
  ${NANOMQ_ROOT}/nanomq/pub_handler.c
  ${NANOMQ_ROOT}/nanomq/sub_handler.c
  ${NANOMQ_ROOT}/nanomq/unsub_handler.c
  ${NANOMQ_ROOT}/nanomq/hashmap.c
  ${NANOMQ_ROOT}/nanomq/rest_api.c
  ${NANOMQ_ROOT}/nanomq/web_server.c
  ${NANOMQ_ROOT}/nanomq/webhook_inproc.c
  ${NANOMQ_ROOT}/nanomq/webhook_post.c
  ${NANOMQ_ROOT}/nanomq/aws_bridge.c
  ${NANOMQ_ROOT}/nanomq/nanomq_rule.c
  ${NANOMQ_ROOT}/nanomq/conf_api.c
  ${NANOMQ_ROOT}/nanomq/cmd_proc.c
  ${NANOMQ_ROOT}/nanomq/acl_handler.c
  ${NANOMQ_ROOT}/nanomq/acl_hazard.c
  ${NANOMQ_ROOT}/nanomq/mqtt_api.c
  ${NANOMQ_ROOT}/nanomq/nanomq.c
  ${NANOMQ_ROOT}/nanomq/apps/broker.c
  ${NANOMQ_ROOT}/nanomq/apps/nng_bridge.c
)

target_include_directories(app PRIVATE
  ${NANOMQ_ROOT}/nanomq
  ${NANOMQ_ROOT}/nanomq/include
  ${NNG_ROOT}/include
)

# Upstream platform/capability macros (root CMakeLists.txt has no Zephyr
# branch and falls into the POSIX else-clause, so it is not reused here):
#   ACL_SUPP      — ENABLE_ACL default ON; conf struct fields follow it
#   ENABLE_LOG    — log calls enabled (SUPP_SYSLOG deliberately NOT set:
#                   Zephyr has no syslog(); nanolib log.c has __ZEPHYR__
#                   output support instead)
#   SUPP_NANO_LIB — hides nanomq.c's main(); keeps get_cache_argc/argv
#                   which rest_api.c references
#   NNG_STATIC_LIB — NNG_DECL decoration (imported lib carries no usage
#                   requirements)
target_compile_definitions(app PRIVATE
  ACL_SUPP
  ENABLE_LOG
  SUPP_NANO_LIB
  NNG_STATIC_LIB
)

# NanoNNG broker-side protocol/transports (upstream sets these as plain
# variables before add_subdirectory(nng); ExternalProject needs them
# passed explicitly as cache vars).
set(NNG_EXTRA_ARGS
  -DNNG_PROTO_MQTT_BROKER=ON
  -DNNG_TRANSPORT_MQTT_BROKER_TCP=ON
  -DNNG_TRANSPORT_MQTT_BROKER_WS=ON
)

# ENABLE_LOG must reach the nng build as a compiler flag (nng's CMake
# only reacts to -DNNG_* cache vars): nanolib conf.c gates conf_log_init()
# on it and nanolib log.h compiles log_*() to no-ops without it — a
# libnng built without ENABLE_LOG leaves conf->log.type unset (broker
# logging dead) even though the app side defines it.
#
# ACL_SUPP likewise gates the conf_acl fields of struct conf
# (conf.h: #ifdef ACL_SUPP → conf_acl acl / acl_nomatch / acl_deny_action,
# 20 bytes).  It is defined on the app side above, so the conf.c compiled
# into libnng MUST see it too, or struct conf layouts disagree between
# libnng and the broker .c files — auth_http lands 20 bytes early in
# libnng's view and start_rest_server() locks a garbage
# auth_http.acl_cache_mtx (pthread_mutex_lock: Invalid argument → nni_panic).
set(NNG_EXTRA_CFLAGS "-DENABLE_LOG -DACL_SUPP")

include(../cmake/nanonng_external.cmake)
```

## Kconfig
```
# NanoMQ broker demo options
#
# An application-level Kconfig file replaces the top of the Zephyr tree
# (kconfig.cmake: KCONFIG_ROOT = <app>/Kconfig when it exists), so the
# whole Zephyr tree must be pulled back in explicitly.  See
# samples/basic/minimal/Kconfig for the same pattern.

config BROKER_LOG_DEBUG
	bool "Set NanoMQ log level to DEBUG"
	help
	  Bumps nanolib log level from the default WARN to DEBUG so the
	  MQTT session flow is visible on the console.  Disable for normal
	  runs (less noise, fewer cycles in log formatting).

config BROKER_REST_API
	bool "Enable the NanoMQ REST API (HTTP tcp:8081, Basic auth)"
	help
	  Sets conf http_server.enable / auth_type=BASIC, so the broker serves
	  /api/v4 over plain HTTP behind Basic auth with the credentials from
	  BROKER_REST_USER / BROKER_REST_PASS below.  Requires an extra SLIRP
	  hostfwd for tcp:8081 (see prj.conf) to be reachable from the host.

	  Basic over plain HTTP is base64, not encryption — TLS is compiled
	  out of the Zephyr NanoNNG.  Keep this off untrusted networks.

config BROKER_REST_USER
	string "REST API Basic-auth username"
	depends on BROKER_REST_API
	default "admin"
	help
	  Username for the REST API's Basic auth.  The default is the value
	  published in etc/nanomq.conf upstream, so it is public knowledge
	  rather than a secret: set your own from a local, git-ignored conf
	  file (see local.conf.example) whenever the REST port is reachable
	  from a network you do not control.  basic_authorize() (rest_api.c)
	  does strlen() on this, so it must not be empty.

config BROKER_REST_PASS
	string "REST API Basic-auth password"
	depends on BROKER_REST_API
	default "public"
	help
	  Password matching BROKER_REST_USER.  Same caveat: "public" is the
	  published demo default, so change it wherever the REST port is
	  reachable beyond your own machine.

config BROKER_WEBHOOK
	bool "Enable the NanoMQ webhook forwarder (POST to BROKER_WEBHOOK_URL)"
	help
	  Sets conf web_hook.enable, an inproc hook channel (Zephyr has no IPC
	  transport) and two rules (MESSAGE_PUBLISH on "hook/#", CLIENT_CONNACK).
	  The receiver URL comes from BROKER_WEBHOOK_URL below; leave that empty
	  and the forwarder stays off.

config BROKER_WEBHOOK_URL
	string "Webhook receiver URL"
	depends on BROKER_WEBHOOK
	default ""
	help
	  Where the broker POSTs event JSON, e.g. "http://10.0.2.2:18080/" or
	  "http://192.168.1.5:18080/".  Must be reachable from the broker and
	  end with a path the receiver serves ("/" is fine).

	  Left empty by default: main.c enables the forwarder only when this
	  is non-empty, and it is deliberately off in both demos — see the
	  BROKER_WEBHOOK help above.

	  qemu_x86: 10.0.2.2 is the SLIRP alias for the machine running qemu,
	  so a receiver started there works as-is.
	  Real board: set this to the LAN address of the machine running
	  hook_receiver.py, e.g. in local.conf.

config BROKER_WS
	bool "Enable the WebSocket listener (MQTT over RFC6455, tcp:8083)"
	help
	  Sets conf websocket.enable / websocket.url in main.c so the broker
	  also accepts MQTT over WebSocket on nmq-ws://0.0.0.0:8083/mqtt.
	  Requires the mqttws transport in the NanoNNG build (enabled by this
	  app's CMakeLists via NNG_TRANSPORT_MQTT_BROKER_WS=ON) and an extra
	  SLIRP hostfwd for tcp:8083 (see prj.conf) to be reachable from the
	  host.  TLS is built out of the Zephyr NanoNNG, so WSS stays inert.

source "Kconfig.zephyr"
```

## prj.conf
```kconfig
# NanoMQ → Zephyr broker demo configuration
#
# Baseline: demo/zephyr_mqtt/prj.conf in NanoNNG (proven on qemu_x86),
# with resource sizing bumped for the broker and SLIRP hostfwd added
# so the host can reach the guest broker on tcp:1883.

# POSIX API — provides pthread, sockets, poll (Zephyr pthread stack comes
# from the dynamic thread pool: DYNAMIC_THREAD_STACK_SIZE below)
CONFIG_POSIX_API=y
CONFIG_POSIX_THREADS=y
CONFIG_POSIX_THREAD_THREADS_MAX=16
# Zephyr POSIX objects come from fixed pools.  nng maps its mutex/condvar
# onto pthread_* , and nni_plat_{mtx,cv}_init RETRY FOREVER when the pool
# is exhausted (nng/src/platform/zephyr/zephyr_thread.c) — an exhausted
# pool stalls the calling thread invisibly (observed: broker boot with
# REST+webhook reaches a 245/256 mutex baseline, then the REST
# inproc_server thread hangs forever in nng_rep0_open trying to grab the
# 246th).  nng's dynamic model (mutex per sock/ctx/aio/work, webhook
# pool_size=32 works x 2 aios each) does not fit small fixed pools, so
# budget generously: 1024 slots cost only ~30 KB of static arrays.
CONFIG_MAX_PTHREAD_MUTEX_COUNT=1024
CONFIG_MAX_PTHREAD_COND_COUNT=1024
# Rwlocks are per topic-tree node (nanolib mqtt_db.c: every dbtree_node_new
# takes one, every dbtree_node_free returns it), so the live count tracks
# distinct topics in the subscription tree, not connections.  32 dies as
# soon as a load test publishes to more than a handful of topics — the
# survival group hit nni_panic("pthread_rwlock_init: pool exhausted") at
# ~30 topics.  Host POSIX builds have no fixed pool at all; Zephyr needs
# the budget spelled out.
CONFIG_MAX_PTHREAD_RWLOCK_COUNT=256
CONFIG_DYNAMIC_THREAD=y
CONFIG_DYNAMIC_THREAD_STACK_SIZE=16384
CONFIG_DYNAMIC_THREAD_ALLOC=y
CONFIG_POLL=y
# Zephyr's zvfs_poll() maps the whole poll() fd set onto ONE shared array
# of k_poll_event's, bounded by CONFIG_ZVFS_POLL_MAX (Kconfig default 3!).
# nng's pollq puts every armed socket into a single poll() call (wake
# "pipe" is a dummy fd that consumes no slot), so the broker needs one
# slot per listener/connection direction: 3 listeners + 2 connections
# already exceeds the default and zvfs_poll then returns -1/ENOMEM on
# every call (nng's pollq would busy-spin and starve all I/O — see
# zephyr_pollq_poll.c error handling).  Budget for the demo scale:
# 3 listeners + up to ~6 concurrent MQTT/webhook conns x 2 directions.
# (The value itself is set with the network pools further down, §7-18.)

# Networking — broker listens on TCP
CONFIG_NETWORKING=y
CONFIG_NET_IPV4=y
CONFIG_NET_TCP=y
CONFIG_NET_SOCKETS=y

# DNS (not strictly needed by the broker, kept for completeness)
CONFIG_DNS_RESOLVER=y
CONFIG_DNS_SERVER_IP_ADDRESSES=y
CONFIG_DNS_RESOLVER_MAX_SERVERS=2

# QEMU user-mode networking with host forward.
# Bound to loopback: qemu runs on this host, the README has clients
# connecting through 127.0.0.1, and keeping the forwards off the LAN means
# the guest's administrative REST port is not exposed to the network by
# default.
#   host tcp:1883  ->  guest 10.0.2.15:1883 (broker listen address)
#   host tcp:8081  ->  guest 10.0.2.15:8081 (REST API, BROKER_REST_API)
#   host tcp:8083  ->  guest 10.0.2.15:8083 (MQTT/WS, BROKER_WS)
CONFIG_NET_QEMU_USER=y
CONFIG_NET_QEMU_USER_EXTRA_ARGS="hostfwd=tcp:127.0.0.1:1883-:1883,hostfwd=tcp:127.0.0.1:8081-:8081,hostfwd=tcp:127.0.0.1:8083-:8083"

# e1000 driver for the qemu_x86 "eth0" node — NET_QEMU_USER only implies
# the Ethernet L2; without the driver there is no real NIC (net_config
# would have put 10.0.2.15 on the loopback iface and SLIRP frames would
# never be received).
CONFIG_ETH_E1000=y

# Static guest IP — SLIRP only forwards to 10.0.2.15 (its fixed notion of
# the guest); without an address on the interface the guest drops every
# forwarded SYN at the IP layer.  net_config applies it in an APPLICATION
# SYS_INIT (before main), so the broker's listen is reachable by the time
# the demo starts.
CONFIG_NET_CONFIG_SETTINGS=y
CONFIG_NET_CONFIG_NEED_IPV4=y
CONFIG_NET_CONFIG_MY_IPV4_ADDR="10.0.2.15"
CONFIG_NET_CONFIG_MY_IPV4_NETMASK="255.255.255.0"
CONFIG_NET_CONFIG_MY_IPV4_GW="10.0.2.2"
CONFIG_NET_CONFIG_AUTO_INIT=y

# Memory and stack sizing — the broker heap holds nng taskq/poller
# threads, work structs, MQTT messages and the nanolib session db.
# Tune CONFIG_HEAP_MEM_POOL_SIZE / *STACK* when enlarging conf->parallel.
CONFIG_HEAP_MEM_POOL_SIZE=524288
CONFIG_MAIN_STACK_SIZE=16384

# nng's Zephyr platform alloc is plain malloc() (zephyr_alloc.c), so the
# libc malloc arena IS the broker heap.  With MMU enabled (qemu_x86's
# default) COMMON_LIBC_MALLOC_ARENA_SIZE defaults to a mere 16384 and
# larger allocations (e.g. per-pipe rlmq resize of msq_len*8 bytes) fail;
# the CONFIG_HEAP_MEM_POOL_SIZE pool above serves k_malloc() only and is
# not used by nng.  Size the arena for the broker workload explicitly.
CONFIG_COMMON_LIBC_MALLOC_ARENA_SIZE=1048576

# Enable FPU so the SSE/SSE2/SSE3/SSSE3 Kconfig options become visible
CONFIG_FPU=y

# CPU instruction sets up to what the emulated CPU (qemu32, CPU_ATOM)
# provides: MMX/SSE/SSE2/SSE3.  SSSE3 must NOT be enabled — qemu32 and
# Zephyr's CPU_ATOM model lack it (Kconfig drops the assignment to n and
# the build aborts on the warning).
CONFIG_X86_SSE=y
CONFIG_X86_SSE2=y
CONFIG_X86_SSE3=y

# Networking buffers — bumped for broker pub/sub forwarding
CONFIG_NET_PKT_RX_COUNT=32
CONFIG_NET_PKT_TX_COUNT=32
CONFIG_NET_BUF_RX_COUNT=64
CONFIG_NET_BUF_TX_COUNT=64

# Zephyr network resource pools — sized for a broker, not a sensor node.
# Every socket (listening or connected) takes one net_context and one
# net_conn, and the defaults (6 / 8) leave only ~3 slots once the three
# listeners (1883 + 8081 + 8083) exist.  When the pool is exhausted Zephyr's TCP
# answers the next SYN with RST — tcp.c tcp_conn_new(): net_context_get()
# fails → "Cannot allocate a new TCP connection" → net_tcp_reply_rst(),
# which the client sees as "Connection reset by peer".  Measured before
# the change: 6 concurrent MQTT connects → 2 CONNACKs; 20 back-to-back
# connects at 50 ms spacing → 9/20; at 300 ms → 20/20.  That is what made
# the CI v5 suite (5-6 concurrent subscribers, sub→pub→sub churn) fail
# intermittently.  Also size the zvfs fd table (ZVFS_OPEN_ADD_SIZE_NET,
# which defaults to NET_MAX_CONTEXTS) and the nng pollq's poll() event
# budget (ZVFS_POLL_MAX: one slot per socket direction).
CONFIG_NET_MAX_CONTEXTS=32
CONFIG_NET_MAX_CONN=32
CONFIG_ZVFS_OPEN_ADD_SIZE_NET=32
CONFIG_ZVFS_POLL_MAX=64

CONFIG_PRINTK=y

# Debug: bump NanoMQ log level to DEBUG (remove for normal runs)
CONFIG_BROKER_LOG_DEBUG=y

# NanoMQ HTTP REST API — conf http_server.enable + BASIC auth with the
# credentials from CONFIG_BROKER_REST_USER / _PASS (Kconfig BROKER_REST_API
# enables the listener).  Served on the tcp:8081 hostfwd above; conf_init
# defaults http_server.enable to false, so without this switch the guest has
# no listener on 8081 and SLIRP answers RST.  Clients must send credentials:
#   curl -u admin:public http://<host>:8081/api/v4/...
# The listener stays off until BROKER_REST_USER/PASS are set to credentials
# of your own (local.conf): they have no default, and the published
# admin/public pair is refused.
# Basic over plain HTTP is base64, not encryption — TLS is out of the
# Zephyr NanoNNG build.
CONFIG_BROKER_REST_API=y

# NanoMQ webhook forwarder — conf web_hook.enable + inproc hook channel +
# MESSAGE_PUBLISH("hook/#") / CLIENT_CONNACK rules in main.c (Kconfig
# BROKER_WEBHOOK).  Event POSTs go to the QEMU-host alias 10.0.2.2, so a
# hook_receiver.py started on the machine running qemu is reachable as-is.
#
# OFF by default, like the ESP32-S3 demo.  The CLIENT_CONNACK rule fires on
# every client connect, so with the forwarder on and no receiver listening
# each connect costs a failed HTTP attempt plus two log lines — that
# measurably perturbs the suite's timing-sensitive subtests (measured on the
# board: 97 failed POSTs in one mqtt_v5 run, retain subtest failing all three
# attempts; PORTING_ZEPHYR.md §22-6).  Enable it only to exercise webhook:
# uncomment both lines below (the URL is what turns the forwarder on —
# main.c checks it is non-empty), or pass an overlay with
#   west build ... -- -DEXTRA_CONF_FILE=webhook.conf
#CONFIG_BROKER_WEBHOOK=y
#CONFIG_BROKER_WEBHOOK_URL="http://10.0.2.2:18080/"

# NanoMQ WebSocket listener — conf websocket.enable + websocket.url in
# main.c (Kconfig BROKER_WS).  MQTT over RFC6455 on nmq-ws://:8083/mqtt,
# served by the mqttws transport in the NanoNNG build (the tcp:8083
# hostfwd above forwards it to the host).  TLS is out of the Zephyr
# NanoNNG, so wss: is inert.
CONFIG_BROKER_WS=y
```

## src/main.c
```c
//
// Zephyr broker entry point — "embedded minimal conf" bootstrap.
//
// Zephyr has no filesystem, so the broker is started with conf_init()
// defaults plus a few field overrides, then broker() is called directly.
// broker_start() (file parsing, daemonize) is deliberately bypassed.
//
// Startup contract with apps/broker.c::broker(conf *):
//   * conf->url non-NULL  → broker listens on it (nmq-tcp:// ...)
//   * conf->ipc_internal  → cmd server over IPC transport; Zephyr build
//                           has NNG_TRANSPORT_IPC=OFF, so it must be false
//   * log_init() must run first: in the normal flow it is called by
//     broker_start_with_conf() right before broker(); broker() itself
//     never touches the nanolib log module
//   * broker() never returns: it parks in for(;;) nng_msleep(3600000)
//
#include <zephyr/kernel.h>
#include <zephyr/sys/printk.h>
#include <zephyr/net/net_if.h>
#include <zephyr/net/net_core.h>
#include <zephyr/sys/clock.h>
#include <string.h>

#include "nng/nng.h"
#include "nng/supplemental/nanolib/conf.h"
#include "nng/supplemental/nanolib/log.h"
#include "mqtt_api.h" // log_init(conf_log *)

#if defined(CONFIG_X86)
#include <time.h>              // time_t
#include <zephyr/sys/sys_io.h> // io_port_t
#include <zephyr/arch/x86/arch.h> // sys_in8()/sys_out8()
#endif

// broker() lives in nanomq/nanomq/apps/broker.c and is not declared in
// broker.h (which only exports broker_start/broker_start_with_conf).
extern int broker(conf *nanomq_conf);

#if defined(CONFIG_X86)
//
// Seed CLOCK_REALTIME from the QEMU-emulated mc146818 (CMOS) RTC.
//
// Zephyr has no timeprovider wired to the PC CMOS RTC, so CLOCK_REALTIME
// starts at the 1970 epoch and nanolib's log timestamps (log.c formats
// time(NULL) with localtime_r) print "1970-01-01 00:00:xx + uptime".
// QEMU's q35 chipset emulates the standard CMOS RTC at I/O ports 0x70/0x71
// and seeds it with the host clock at launch (default `-rtc base=utc`),
// so reading it once at boot and handing it to sys_clock_settime() gives
// real timestamps from then on (lib/os/clock.c: realtime = offset+uptime,
// so the clock keeps tracking without further updates).
//

#define CMOS_PORT_IDX   0x70U
#define CMOS_PORT_DAT   0x71U
#define CMOS_REG_SEC    0x00U
#define CMOS_REG_MIN    0x02U
#define CMOS_REG_HOUR   0x04U
#define CMOS_REG_DAY    0x07U
#define CMOS_REG_MON    0x08U
#define CMOS_REG_YEAR   0x09U
#define CMOS_REG_STAT_A 0x0AU
#define CMOS_REG_STAT_B 0x0BU
#define CMOS_UIP_BIT    0x80U /* STAT_A: update in progress */
#define CMOS_24H_BIT    0x02U /* STAT_B: 0 = 12 h mode */
#define CMOS_BIN_BIT    0x04U /* STAT_B: 0 = BCD, 1 = binary */

static uint8_t
cmos_read(uint8_t reg)
{
	uint8_t v;

	// Bit 7 of the index byte disables NMI while addressing the RTC.
	// Re-select the same register with bit 7 clear afterwards, so the
	// broker does not leave the CPU's NMI masked for the rest of the run.
	sys_out8((uint8_t) (reg | 0x80U), CMOS_PORT_IDX);
	v = sys_in8(CMOS_PORT_DAT);
	sys_out8(reg, CMOS_PORT_IDX);
	return v;
}

static uint8_t
cmos_bcd2bin(uint8_t v)
{
	return (uint8_t) (((v >> 4) & 0x0FU) * 10U + (v & 0x0FU));
}

// days_from_civil(): Howard Hinnant's algorithm, proleptic Gregorian —
// avoids libc mktime()/TZ involvement (the CMOS clock is UTC).
static int64_t
days_from_civil(int64_t y, unsigned m, unsigned d)
{
	int64_t era;
	unsigned yoe, doe, doy;

	y -= (m <= 2U);
	era = (y >= 0 ? y : y - 399) / 400;
	yoe = (unsigned) (y - era * 400);
	doy = (153U * (m + (m > 2U ? -3U : 9U)) + 2U) / 5U + d - 1U;
	doe = yoe * 365U + yoe / 4U - yoe / 100U + doy;

	return era * 146097 + (int64_t) doe - 719468;
}

static int
cmos_read_datetime(uint8_t *secp, uint8_t *minp, uint8_t *hourp, uint8_t *dayp,
    uint8_t *monp, uint8_t *yearp)
{
	uint8_t s1, s2;
	int     i;

	// Re-read until the seconds register is stable across the whole
	// read (the RTC updates once per second; reads must not straddle it).
	for (i = 0; i < 8; i++) {
		s1    = cmos_read(CMOS_REG_SEC);
		*minp = cmos_read(CMOS_REG_MIN);
		*hourp = cmos_read(CMOS_REG_HOUR);
		*dayp = cmos_read(CMOS_REG_DAY);
		*monp = cmos_read(CMOS_REG_MON);
		*yearp = cmos_read(CMOS_REG_YEAR);
		s2    = cmos_read(CMOS_REG_SEC);
		if (s1 == s2) {
			*secp = s1;
			return (0);
		}
	}

	return (-1);
}

static void
seed_realtime_from_cmos(void)
{
	struct timespec ts;
	uint8_t sec, min, hour, day, mon, year, stat_b;
	bool binary, h24, pm = false;
	unsigned tries, y_full;
	int64_t epoch;

	// Wait out any update-in-progress cycle before touching the regs.
	for (tries = 0; tries < 1000; tries++) {
		if ((cmos_read(CMOS_REG_STAT_A) & CMOS_UIP_BIT) == 0U) {
			break;
		}
	}
	if (cmos_read_datetime(&sec, &min, &hour, &day, &mon, &year) != 0) {
		printk("rtc: CMOS read straddled an update, keeping 1970 epoch\n");
		return;
	}
	stat_b = cmos_read(CMOS_REG_STAT_B);
	binary = (stat_b & CMOS_BIN_BIT) != 0;
	h24    = (stat_b & CMOS_24H_BIT) != 0;

	// 12 h mode keeps the PM flag in bit 7 of the hour register.  Take it
	// off before the BCD conversion: cmos_bcd2bin(0x92) would otherwise
	// turn 12 PM into 92 and the range check below would reject it.
	if (!h24) {
		pm = (hour & 0x80U) != 0;
		hour &= 0x7FU;
	}

	if (!binary) {
		sec  = cmos_bcd2bin(sec);
		min  = cmos_bcd2bin(min);
		hour = cmos_bcd2bin(hour);
		day  = cmos_bcd2bin(day);
		mon  = cmos_bcd2bin(mon);
		year = cmos_bcd2bin(year);
	}
	if (!h24) {
		if (pm) {
			if (hour != 12U) {
				hour += 12U;
			}
		} else if (hour == 12U) {
			hour = 0;
		}
	}

	// Sanity checks: 2-digit year mapped onto 1970-2069, valid date.
	y_full = (year >= 70U) ? (1900U + year) : (2000U + year);
	if (y_full < 2000U || y_full > 2099U || mon < 1U || mon > 12U ||
	    day < 1U || day > 31U || hour > 23U || min > 59U || sec > 59U) {
		printk("rtc: CMOS time out of range (%04u-%02u-%02u %02u:%02u:%02u)\n",
		    y_full, mon, day, hour, min, sec);
		return;
	}
	epoch = days_from_civil(y_full, mon, day) * 86400 +
	    hour * 3600 + min * 60 + sec;

	ts.tv_sec  = (time_t) epoch;
	ts.tv_nsec = 0;
	(void) sys_clock_settime(SYS_CLOCK_REALTIME, &ts);

	printk("rtc: CMOS clock %04u-%02u-%02u %02u:%02u:%02u UTC, realtime seeded\n",
	    y_full, mon, day, hour, min, sec);
}
#endif // CONFIG_X86

static void
dump_iface_ipv4_cb(struct net_if *iface, struct net_if_addr *ifaddr, void *user_data)
{
	char buf[NET_IPV4_ADDR_LEN];

	if (ifaddr->address.family == AF_INET && ifaddr->addr_type == NET_ADDR_MANUAL) {
		printk("net: ipv4 %s\n", net_addr_ntop(
			AF_INET, &ifaddr->address.in_addr, buf, sizeof(buf)));
	}
	ARG_UNUSED(iface);
	ARG_UNUSED(user_data);
}

static void
dump_iface_ipv4(struct net_if *iface)
{
	if (iface != NULL) {
		net_if_ipv4_addr_foreach(iface, dump_iface_ipv4_cb, NULL);
	}
}

static void
list_iface_cb(struct net_if *iface, void *user_data)
{
	const struct device *dev = net_if_get_device(iface);

	printk("net: iface %p dev=%s up=%d\n", (void *) iface,
	       dev == NULL ? "(null)" : dev->name, net_if_is_up(iface));
	if (user_data != NULL) {
		dump_iface_ipv4(iface);
	}
}

static void
dump_ifaces(void)
{
	net_if_foreach(list_iface_cb, (void *) 1);
}

void
main(void)
{
	conf *nmq_conf;

#if defined(CONFIG_X86)
	// Real wall clock before the broker (and nanolib log_init) starts
	// printing timestamps.
	seed_realtime_from_cmos();
#endif

	if ((nmq_conf = nng_zalloc(sizeof(conf))) == NULL) {
		printk("Cannot allocate configuration, quit\n");
		return;
	}

	conf_init(nmq_conf);

	dump_ifaces();

	// Embedded minimal conf: defaults + key overrides.
	nmq_conf->url          = "nmq-tcp://0.0.0.0:1883";
	nmq_conf->ipc_internal = false; // cmd/reload server needs IPC transport
	nmq_conf->daemon       = false;
	// The QoS/keepalive/session machinery ticks on qos_duration (conf_init
	// default 10s): offline-queued QoS>0 messages only become eligible for
	// redelivery after qos_duration*1.25s (broker_tcp.c GET_QOS_RESEND) and
	// keepalive/session expiry are checked once per qos_duration.  Shorten
	// to 1s so persistent-session & keepalive scenarios respond promptly.
	nmq_conf->qos_duration = 1;
	// MQTT 5 topic aliases.  conf_init leaves max_topic_alias 0, so the
	// CONNACK advertises TOPIC_ALIAS_MAXIMUM=0 and every PUBLISH carrying a
	// topic alias is rejected (pub_handler.c handle_pub → "Invalid Topic
	// Alias ... Server Max allowed: 0").  The host test conf sets 1024
	// (.github/scripts/nanomq.conf on master); mirror it so the CI v5
	// suite's topic-alias case means the same thing here.
	nmq_conf->max_topic_alias = 1024;
#ifdef CONFIG_BROKER_LOG_DEBUG
	nmq_conf->log.level    = NNG_LOG_DEBUG;
#endif

#ifdef CONFIG_BROKER_REST_API
	// REST API on plain HTTP with Basic auth.  broker() calls
	// start_rest_server() itself (apps/broker.c); the http server is a
	// separate TCP listener (conf default ip 0.0.0.0, port 8081) bridged
	// into the broker socket over inproc REQ/REP.
	//
	// auth_type defaults to BASIC, but conf_http_server_init() leaves
	// username/password NULL — and basic_authorize() (rest_api.c) does
	// strlen() on both, so the credentials must be filled in here or the
	// first REST request dereferences NULL.  They come from Kconfig
	// (BROKER_REST_USER/PASS) rather than from this file, so a deployment
	// can set its own from local.conf without patching C.
	//
	// NB: Basic over plain HTTP is base64, not encryption — TLS is
	// compiled out of the Zephyr NanoNNG, so keep this off untrusted
	// networks regardless.
	nmq_conf->http_server.enable    = true;
	nmq_conf->http_server.auth_type = BASIC;
	nmq_conf->http_server.username  = nng_strdup(CONFIG_BROKER_REST_USER);
	nmq_conf->http_server.password  = nng_strdup(CONFIG_BROKER_REST_PASS);

	if (strcmp(CONFIG_BROKER_REST_USER, "admin") == 0 &&
	    strcmp(CONFIG_BROKER_REST_PASS, "public") == 0) {
		printk("rest: WARNING serving tcp:8081 with the published "
		    "default credentials admin/public - set "
		    "CONFIG_BROKER_REST_USER/PASS (local.conf) before "
		    "exposing this port\n");
	}
#endif

#ifdef CONFIG_BROKER_WS
	// WebSocket listener (MQTT over RFC6455, paho's default path /mqtt).
	// broker() listens on websocket.url verbatim — the CONF_WS_URL_DEFAULT
	// fallback lives in the broker_start*() file path, which this demo
	// bypasses — so both fields must be set here.  TLS is compiled out of
	// the Zephyr NanoNNG, so the wss: sibling listener stays inert.
	nmq_conf->websocket.enable = true;
	nmq_conf->websocket.url    = "nmq-ws://0.0.0.0:8083/mqtt";
#endif

#ifdef CONFIG_BROKER_WEBHOOK
	// Webhook forwarder: broker pushes event JSON into the hook channel
	// and a dedicated thread POSTs it to web_hook.url with the nng HTTP
	// client (fire-and-forget; slow receivers never block the broker).
	// The default hook channel is ipc:///tmp/... — Zephyr has no IPC
	// transport (NNG_TRANSPORT_IPC=OFF), so it must be inproc.
	//
	// The receiver URL is a build-time setting (CONFIG_BROKER_WEBHOOK_URL):
	// 10.0.2.2 is the SLIRP alias for the machine running qemu, so a
	// receiver started there works as-is.  With the URL left empty the
	// forwarder stays disabled rather than POSTing into the void.
	if (strlen(CONFIG_BROKER_WEBHOOK_URL) > 0) {
		// Every allocation here can fail and the rules are filled in field
		// by field, so build them first and only switch the forwarder on
		// once all of them succeeded.  nng_free(NULL, ...) is a no-op, so
		// the failure path can free unconditionally.
		conf_web_hook_rule *hook_msg =
		    nng_zalloc(sizeof(conf_web_hook_rule));
		conf_web_hook_rule *hook_conn =
		    nng_zalloc(sizeof(conf_web_hook_rule));
		conf_web_hook_rule **rules =
		    nng_zalloc(2 * sizeof(conf_web_hook_rule *));
		char *hook_topic = nng_strdup("hook/#");

		if (hook_msg != NULL && hook_conn != NULL && rules != NULL &&
		    hook_topic != NULL) {
			hook_msg->event  = MESSAGE_PUBLISH; // every publish
			hook_msg->topic  = hook_topic;
			hook_conn->event = CLIENT_CONNACK;  // every connect
			rules[0]         = hook_msg;
			rules[1]         = hook_conn;

			nmq_conf->web_hook.enable     = true;
			nmq_conf->web_hook.url =
			    nng_strdup(CONFIG_BROKER_WEBHOOK_URL);
			nmq_conf->hook_ipc_url =
			    nng_strdup("inproc://nanomq_hook");
			nmq_conf->web_hook.rules      = rules;
			nmq_conf->web_hook.rule_count = 2;
		} else {
			printk("webhook: allocation failed, forwarder stays off\n");
			nng_free(hook_msg, sizeof(conf_web_hook_rule));
			nng_free(hook_conn, sizeof(conf_web_hook_rule));
			nng_free(rules, 2 * sizeof(conf_web_hook_rule *));
			nng_free(hook_topic, sizeof("hook/#"));
		}
	}
#endif

#if defined(ENABLE_LOG)
	// Activate the nanolib log backend (console) and apply conf->log.level
	// — broker_start_with_conf() normally does this, but the embedded demo
	// calls broker() directly.
	log_init(&nmq_conf->log);
	// Use the configured level rather than a fixed WARN: with
	// CONFIG_BROKER_LOG_DEBUG the level set above is DEBUG, and a
	// hard-coded WARN sink filters everything below it straight back out.
	log_add_console(nmq_conf->log.level, NULL);
#endif

	broker(nmq_conf);

	// broker() only returns on (unreachable) test paths.
	printk("NanoMQ broker exited unexpectedly\n");
}
```

## src/process_stub.c
```c
//
// Zephyr stand-in for nanomq/process.c.
//
// The upstream process.c is pure POSIX (fork/kill/chdir, <paths.h>) and
// cannot be built on Zephyr.  Its public symbols (nanomq/nanomq/
// include/process.h) are referenced from apps/broker.c but only behind
// `daemon == true` / CLI paths that are never taken by the embedded
// broker (conf_init defaults daemon=false; main.c calls broker() directly,
// bypassing broker_start()).  Provide error-returning stubs so the
// broker object links.
//
#include "include/process.h"

int
process_is_alive(int pid)
{
	(void) pid;
	return (-1);
}

int
process_send_signal(int pid, int signal)
{
	(void) pid;
	(void) signal;
	return (-1);
}

int
pidgrp_send_signal(int pid, int signal)
{
	(void) pid;
	(void) signal;
	return (-1);
}

int
process_daemonize(void)
{
	return (-1);
}

int
process_create_child(int (*child_run)(void *), void *data)
{
	(void) child_run;
	(void) data;
	return (-1);
}
```
